## src/audio/mfcc/Kconfig
```kconfig
# SPDX-License-Identifier: BSD-3-Clause

config COMP_MFCC
	tristate "MFCC component"
	depends on COMP_MODULE_ADAPTER
	select CORDIC_FIXED
	select MATH_32BIT_FFT
	select MATH_32BIT_MEL_FILTERBANK
	select MATH_AUDITORY
	select MATH_DCT
	select MATH_DECIBELS
	select MATH_FFT
	select MATH_MATRIX
	select MATH_WINDOW
	select NATURAL_LOGARITHM_FIXED
	select NUMBERS_NORM
	select SQRT_FIXED
	default m if LIBRARY_DEFAULT_MODULAR
	default y
	help
	  This option enables build of a Mel-frequency cepstral coefficients
	  (MFCC) audio features extractor component. It converts the input
	  audio stream into encoded audio data for cepstral coefficients.
	  The characteristic of the audio features are defined in the binary
	  control blob. Directory tools/tune/mfcc contains a tool to create
	  the configurations.

config COMP_MFCC_VAD
	bool "MFCC Voice Activity Detection"
	depends on COMP_MFCC
	default n
	help
	  This option enables a Voice Activity Detector (VAD) that operates
	  on the Mel spectrum values produced by the MFCC component. The VAD
	  flag is inserted into the output stream as the first int32_t value
	  after the magic header word. The VAD tracks a per-bin noise floor
	  and detects speech using a weighted energy delta with hangover.
```

## src/audio/phase_vocoder/Kconfig
```kconfig
# SPDX-License-Identifier: BSD-3-Clause

config COMP_PHASE_VOCODER
	tristate "Phase Vocoder component"
	default n
	select MATH_FFT
	select MATH_32BIT_FFT
	help
	  Select for phase_vocoder component. The component provides
	  render speed control in range 0.5-2.0 while preserving
	  audio content pitch.
```

## src/audio/stft_process/Kconfig.simd
```kconfig
# SPDX-License-Identifier: BSD-3-Clause

comment "STFT Process optimization level select"

choice "COMP_STFT_PROCESS_SIMD_LEVEL_SELECT"
	prompt "choose which SIMD level used for STFT Process module"
	depends on COMP_STFT_PROCESS
	default COMP_STFT_PROCESS_HIFI_MAX

	config COMP_STFT_PROCESS_HIFI_MAX
		prompt "SIMD will selected by toolchain pre-defined header"
		bool
		help
			When this was selected, optimization level will be determined
			by toolchain pre-defined macros in core isa header file.

	config COMP_STFT_PROCESS_HIFI_3
		prompt "choose HIFI3 intrinsic optimized STFT Process module"
		bool
		help
			This option used to build HIFI3 intrinsic optimized STFT
			Process code

	config COMP_STFT_PROCESS_HIFI_NONE
		prompt "choose generic C STFT Process module, no HIFI SIMD involved"
		bool
		help
			This option used to build STFT Process generic code.
endchoice
```
